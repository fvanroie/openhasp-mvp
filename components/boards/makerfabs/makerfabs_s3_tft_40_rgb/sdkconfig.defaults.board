## components/boards/makerfabs/makerfabs_s3_tft_40_rgb/sdkconfig.defaults.board
```kconfig
# ============================================================
# Makerfabs ESP32-S3 Parallel TFT 4.0
# ESP32-S3-WROOM-1-N16R8
# ============================================================

CONFIG_BOARD_LVGL_USE_RGB_3WIRE_SPI=y

# 16 MB Flash
CONFIG_ESPTOOLPY_FLASHSIZE_16MB=y

# 8 MB Octal PSRAM
CONFIG_SPIRAM=y
CONFIG_SPIRAM_MODE_OCT=y
CONFIG_SPIRAM_TYPE_AUTO=y
```

## esp/sdkconfig.defaults
```kconfig
# ============================================================
# LVGL
# ============================================================

CONFIG_FREERTOS_HZ=1000
CONFIG_LV_USE_OS=LV_OS_FREERTOS
CONFIG_LV_OS_FREERTOS=y

CONFIG_LV_USE_CLIB_MALLOC=y
CONFIG_LV_USE_CLIB_STRING=y
CONFIG_LV_USE_CLIB_SPRINTF=y

CONFIG_LV_DEF_REFR_PERIOD=33

CONFIG_LV_OBJ_STYLE_CACHE=y

CONFIG_LV_USE_LOG=y
CONFIG_LV_LOG_LEVEL=LV_LOG_LEVEL_INFO
CONFIG_LV_LOG_PRINTF=n

CONFIG_LV_USE_FREETYPE=y

# Don't compile LVGL example applications
CONFIG_LV_BUILD_EXAMPLES=n

# Performance
CONFIG_COMPILER_OPTIMIZATION_PERF=y

CONFIG_LV_USE_SYSMON=y
# CONFIG_LV_USE_PERF_MONITOR=y
CONFIG_LV_USE_OBSERVER=y

# ============================================================
# LVGL Adapter
# ============================================================

# CONFIG_ESP_LVGL_ADAPTER_ENABLE_FPS_STATS=y
CONFIG_ESP_LVGL_ADAPTER_ENABLE_FS=y
CONFIG_ESP_LVGL_ADAPTER_ENABLE_DECODER=y
CONFIG_ESP_LVGL_ADAPTER_ENABLE_FREETYPE=y
CONFIG_ESP_LVGL_ADAPTER_FREETYPE_MINIMAL_BUILD=y
CONFIG_ESP_LVGL_ADAPTER_FREETYPE_SMALL_RENDER_POOL=y

# ============================================================
# HTTP + WS
# ============================================================

CONFIG_HTTPD_WS_SUPPORT=y
CONFIG_HTTPD_WS_PRE_HANDSHAKE_CB_SUPPORT=y
```

## main/Kconfig.projbuild
```kconfig
menu "openHASP Board Configuration"

config BOARD_LVGL_USE_DSI
    bool "Use DSI LCD support"
    default n
    help
        Enable LVGL support for DSI LCD panels.

config BOARD_LVGL_USE_RGB
    bool "Use RGB LCD support"
    default n
    help
        Enable LVGL support for RGB LCD panels.

config BOARD_LVGL_USE_RGB_3WIRE_SPI
    bool "Use RGB+3-wire SPI LCD support"
    default n
    help
        Enable LVGL support for LCD panels using an RGB pixel bus
        with a 3-wire SPI command/initialization interface.

endmenu
```
